## package/batocera/emulators/zesarux/Config.in
```kconfig
config BR2_PACKAGE_ZESARUX
    bool "zesarux"
    help
      ZEsarUX - ZX Second-Emulator And Released for UniX

      https://github.com/chernandezba/zesarux
```
